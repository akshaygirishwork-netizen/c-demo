## u-boot/kernel.its
```
/dts-v1/;

/ {
    description = "Yocto Kernel FIT Image";
    #address-cells = <1>;

    images {
        kernel {
            description = "Linux Kernel";
            data = /incbin/("uImage");   /* path to your kernel */
            type = "kernel";
            arch = "arm";
            os = "linux";
            compression = "none";
            hash@1 {
                algo = "sha256";
            };
        };
        fdt {
            description = "Device Tree Blob";
            data = /incbin/("bcm2711-rpi-4-b-raspberrypi4.dtb");  /* path to your DTB */
            type = "flat_dt";
            arch = "arm";
            hash@1 {
                algo = "sha256";
            };
        };
    };

    configurations {
        default = "conf";
        conf {
            kernel = "kernel";
            fdt = "fdt";
        };
    };
};
```
